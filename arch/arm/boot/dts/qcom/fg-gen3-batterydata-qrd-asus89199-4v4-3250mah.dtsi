qcom,fg-gen3-batterydata-qrd-asus89199-4v4-3250mah {
	qcom, = <24>;
	/* #3050812_Wingtech_C11P1618scud_3250mAh_averaged_MasterSlave_Aug14th2017*/
	qcom,max-voltage-uv = <4380000>;
	qcom,nom-batt-capacity-mah = <3250>;
	qcom,batt-id-kohm = <51>;
	qcom,battery-beta = <3435>;
	qcom,battery-type = "ASUS-C11P1618";
	qcom,checksum = <0x6922>;
	qcom,gui-version = "PM660GUI - 0.0.0.44";
	qcom,fg-profile-data = [
		 7A 1F A7 05
		 75 0A 4F 06
		 7F 1D DE F4
		 58 12 0C 14
		 39 19 2A 22
		 0E 3D B2 4A
		 52 00 00 00
		 15 00 00 00
		 00 00 29 BC
		 29 C5 47 8B
		 18 00 08 00
		 61 DA 0A E5
		 5F FD A4 00
		 8D 00 0A 12
		 85 FD 8E 2A
		 1F 06 09 20
		 27 00 14 00
		 AD 1F A5 05
		 68 0A C9 FC
		 62 1D 41 EA
		 AF 0A 1A 15
		 1D 19 F7 22
		 59 45 35 53
		 54 00 00 00
		 0D 00 00 00
		 00 00 CA CC
		 5B B2 47 8B
		 14 00 00 00
		 5F EA 0A E5
		 E3 FD BD EB
		 A1 E4 EE 03
		 3A 0A 35 22
		 C2 33 CC FF
		 07 10 00 00
		 71 0C 14 46
		 14 00 40 00
		 AB 01 0A FA
		 FF 00 00 00
		 00 00 00 00
		 00 00 00 00
		 00 00 00 00
		 00 00 00 00
		 00 00 00 00
		 00 00 00 00
		 00 00 00 00
		 00 00 00 00
		 00 00 00 00
		 00 00 00 00
		 00 00 00 00
		 00 00 00 00
		 00 00 00 00
		 00 00 00 00
		 00 00 00 00
		 00 00 00 00
		 00 00 00 00
		 00 00 00 00
	];
};
